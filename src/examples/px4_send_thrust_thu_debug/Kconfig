## src/examples/px4_send_thrust_thu_debug/Kconfig
```kconfig
menuconfig EXAMPLES_PX4_SEND_THRUST_THU_DEBUG
	bool "px4_send_thrust_thu_debug"
	default n
	---help---
		Enable support for px4_send_thrust_thu_debug
```

## src/examples/swept/Kconfig
```kconfig
menuconfig EXAMPLES_SWEPT
	bool "swept"
	default n
	---help---
		Enable support for swept and retract
```
